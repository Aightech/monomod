## firmware/bringup/lis3dh_test/sdkconfig.defaults
```kconfig
# LIS3DH bring-up test — XIAO ESP32-C3
CONFIG_IDF_TARGET="esp32c3"

# XIAO C3 has no UART bridge: console + flashing go over USB-Serial/JTAG
CONFIG_ESP_CONSOLE_USB_SERIAL_JTAG=y

CONFIG_FREERTOS_HZ=1000
CONFIG_FREERTOS_UNICORE=y
CONFIG_LOG_DEFAULT_LEVEL_INFO=y
```

## firmware/components/monomod_board/Kconfig
```kconfig
menu "MONOMOD Board"

choice MONOMOD_BOARD
    prompt "Carrier board (D-label -> GPIO mapping)"
    default MONOMOD_BOARD_XIAO_S3 if IDF_TARGET_ESP32S3
    default MONOMOD_BOARD_XIAO_C3
    help
        Select the carrier board. This only changes how the silk "D" labels map
        to GPIO numbers (see monomod_board/include/board_pins.h); firmware refers
        to D-labels so the same code builds for any board. The default tracks the
        build target (XIAO ESP32-S3 for esp32s3, XIAO ESP32-C3 otherwise).

    config MONOMOD_BOARD_XIAO_C3
        bool "Seeed XIAO ESP32-C3"

    config MONOMOD_BOARD_SUPERMINI_C3
        bool "ESP32-C3 Super Mini"

    config MONOMOD_BOARD_XIAO_S3
        bool "Seeed XIAO ESP32-S3"

endchoice

endmenu
```

## firmware/lis3dh_node/sdkconfig.defaults
```kconfig
# MONOMOD LIS3DH node — XIAO ESP32-C3
CONFIG_IDF_TARGET="esp32c3"

# XIAO C3 has no UART bridge: console + flashing + WiFi provisioning over USB
CONFIG_ESP_CONSOLE_USB_SERIAL_JTAG=y

# FreeRTOS at 1 kHz so a 1 ms vTaskDelayUntil gives a clean 1 kHz EMG loop
CONFIG_FREERTOS_HZ=1000
CONFIG_FREERTOS_UNICORE=y

# WiFi / LWIP — mirror the main firmware's UDP-streaming tuning
CONFIG_ESP_WIFI_DYNAMIC_TX_BUFFER_NUM=32
CONFIG_ESP_WIFI_AMPDU_TX_ENABLED=y
CONFIG_LWIP_UDP_RECVMBOX_SIZE=32

# Stack sizes — the IDF defaults are too small for the WiFi/IP event-handler
# call chain (sys_evt overflowed in vfprintf). Match the main firmware.
CONFIG_ESP_SYSTEM_EVENT_TASK_STACK_SIZE=4096
CONFIG_ESP_MAIN_TASK_STACK_SIZE=8192

# Task watchdog: panic+reboot if a registered task (e.g. tx stuck in sendto)
# starves the scheduler. The tx task subscribes via esp_task_wdt_add().
CONFIG_ESP_TASK_WDT_INIT=y
CONFIG_ESP_TASK_WDT_PANIC=y

CONFIG_LOG_DEFAULT_LEVEL_INFO=y
```

## firmware/sdkconfig.defaults
```kconfig
# MONOMOD Firmware - ESP32-C3 Configuration
CONFIG_IDF_TARGET="esp32c3"

# Flash size (4MB)
CONFIG_ESPTOOLPY_FLASHSIZE_4MB=y

# Partition table
CONFIG_PARTITION_TABLE_CUSTOM=y
CONFIG_PARTITION_TABLE_CUSTOM_FILENAME="partitions.csv"

# FreeRTOS
CONFIG_FREERTOS_HZ=1000
CONFIG_FREERTOS_UNICORE=y

# WiFi
CONFIG_ESP_WIFI_STATIC_RX_BUFFER_NUM=6
CONFIG_ESP_WIFI_DYNAMIC_RX_BUFFER_NUM=16
CONFIG_ESP_WIFI_DYNAMIC_TX_BUFFER_NUM=32
CONFIG_ESP_WIFI_AMPDU_TX_ENABLED=y
CONFIG_ESP_WIFI_AMPDU_RX_ENABLED=y
CONFIG_ESP_WIFI_SOFTAP_SUPPORT=y

# LWIP tuning
CONFIG_LWIP_UDP_RECVMBOX_SIZE=32
CONFIG_LWIP_SO_RCVBUF=y

# Logging
CONFIG_LOG_DEFAULT_LEVEL_INFO=y
CONFIG_LOG_MAXIMUM_LEVEL_DEBUG=y

# Console via USB Serial/JTAG (XIAO ESP32-C3 uses USB for console)
CONFIG_ESP_CONSOLE_USB_SERIAL_JTAG=y

# System
CONFIG_ESP_SYSTEM_EVENT_TASK_STACK_SIZE=4096
CONFIG_ESP_MAIN_TASK_STACK_SIZE=8192
```
